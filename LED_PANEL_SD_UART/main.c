/************************************************************************
 * LED Display Panel
 * Now with UART interface to PC!
 * 
 * 
 ************************************************************************/

#include <stdint.h>
#include <stdio.h>
#include <string.h>
#include <stdlib.h> // atoi

#include <avr/io.h>
#include <avr/interrupt.h>
#include <avr/pgmspace.h>

#include "global.h" // F_CPU may be req'd by other imports
#include "rprintf.h"
#include "WS2812.h"
#include "bufferchris.h"
#include "uartchris.h"
#include "commandprotocol.h"

#include <util/delay.h> // depends on FCPU in global.h

// define global variables
u08 buf[NUM_LEDS]; // half display
u16 bufindex;
char myVolatileStr[40];

// function prototypes
void processCmd(void);
void setVolatileString(unsigned char *);
unsigned char * getVolatileString(void);
void loopRefreshingDisplay(void);

/*************************************************/
/*************************************************/
/* BLOCK 1-4: USS Christmas tree scene, snowing. */
// BMP data has two bytes of zeroes at the end of each line,
// but this is edited out by Hex Editor NEO.
/*************************************************/
/*************************************************/

// Created with HHD Software Hex Editor Neo
// http://www.hhdsoftware.com
//
// File: C:\Users\Chris\Pictures\ussxmas3.bmp
//
// Block n:
// Offset: 0x00000036 (54)
// Size: 0x00000a52 (2,642) bytes

const u08 block1[] PROGMEM = {
	0xe4, 0xe7, 0xff, 0xe3, 0xe7, 0xff, 0xe0, 0xe4, 0xff, 0xe1, 0xe5, 0xff, 0xe2, 0xe6, 0xff, 0xe4,
	0xe7, 0xff, 0xe6, 0xea, 0xff, 0xe7, 0xeb, 0xff, 0xe3, 0xe7, 0xff, 0xdf, 0xe2, 0xff, 0xe1, 0xe5,
	0xff, 0xe1, 0xe4, 0xff, 0xd6, 0xda, 0xff, 0xcd, 0xd0, 0xff, 0xc7, 0xca, 0xff, 0xc4, 0xc7, 0xff,
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	0x00, 0x00
};
// End of Block 1

const u08 block2[] PROGMEM = {
	0xe4, 0xe7, 0xff, 0xe3, 0xe7, 0xff, 0xe0, 0xe4, 0xff, 0xe1, 0xe5, 0xff, 0xe2, 0xe6, 0xff, 0xe4,
	0xe7, 0xff, 0xe6, 0xea, 0xff, 0xe7, 0xeb, 0xff, 0xe3, 0xe7, 0xff, 0xdf, 0xe2, 0xff, 0xe1, 0xe5,
	0xff, 0xe1, 0xe4, 0xff, 0xd6, 0xda, 0xff, 0xcd, 0xd0, 0xff, 0xc7, 0xca, 0xff, 0xc4, 0xc7, 0xff,
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	0x00, 0x00
};
// End of Block 2

const u08 block3[] PROGMEM = {
	0xe4, 0xe7, 0xff, 0xe3, 0xe7, 0xff, 0xe0, 0xe4, 0xff, 0xe1, 0xe5, 0xff, 0xe2, 0xe6, 0xff, 0xe4,
	0xe7, 0xff, 0xe6, 0xea, 0xff, 0xe7, 0xeb, 0xff, 0xe3, 0xe7, 0xff, 0xdf, 0xe2, 0xff, 0xe1, 0xe5,
	0xff, 0xe1, 0xe4, 0xff, 0xd6, 0xda, 0xff, 0xcd, 0xd0, 0xff, 0xc7, 0xca, 0xff, 0xc4, 0xc7, 0xff,
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	0x00, 0x00
};
// End of Block 3

const u08 block4[] PROGMEM = {
	0xe4, 0xe7, 0xff, 0xe3, 0xe7, 0xff, 0xe0, 0xe4, 0xff, 0xe1, 0xe5, 0xff, 0xe2, 0xe6, 0xff, 0xe4,
	0xe7, 0xff, 0xe6, 0xea, 0xff, 0xe7, 0xeb, 0xff, 0xe3, 0xe7, 0xff, 0xdf, 0xe2, 0xff, 0xe1, 0xe5,
	0xff, 0xe1, 0xe4, 0xff, 0xd6, 0xda, 0xff, 0xcd, 0xd0, 0xff, 0xc7, 0xca, 0xff, 0xc4, 0xc7, 0xff,
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	0x00, 0x00
};
// End of Block 4


/**************************************************
 * Start of pgm:
 */
int main(void) {
	
	DDRD |= (1 << DDD3); // set PD3 to OUTPUT
	DDRD |= (1 << DDD4); // set PD4 to OUTPUT
  
  DDRD |= (1 << DDD5); // set PD4 to OUTPUT for testing - led blink
  PORTD |= (1 << PIND5); // DEBUG TURN ON LED INDICATOR
  _delay_ms(100);
  PORTD &= ~(1 << PIND5); // DEBUG TURN OFF LED INDICATOR

  /*************************
   * UART initialization stuff
   */
  uartInit();
  //uartSetBaudRate(9600);
  
  /*************************
   * Command Protocol Library initialization stuff
   */
  // set library function to handle bytes received over UART (and other stuff)
  initCmdHandler();
  // set address, if not already in eeprom
  initCommandProtocolAddr(CMD_UART_THIS_DEVICE_ADDRESS);
  sprintf_P((char *)sprintbuf,PSTR("testing %d$"), 10);
  uartSendBuffer((char *)sprintbuf, 10);
  
  uartSendByte('a');PORTD |= (1 << PIND5); // DEBUG TURN ON LED INDICATOR
  uartSendByte('b');
  /* Loop forever, handle uart messages if we get any */
  while (1) {
    u08 rc; 
    
    if (rxCompleteFlag) {
      beginCmdProcessing(); // follow command protocol
      processCmd(); // interpret the current waiting command
      endCmdProcessing(); // follow command protocol
    }
    
  }
  loopRefreshingDisplay(); // put the old loop in a subroutine

}

/*********************************************************************
 * processCmd:
 *
 * Call this routine to set up flags for mainline or Interrupt Service
 * Routines to execute commands, or if simple and quick, execute 
 * commands immediately.
 *
 * rxCommandProcessing blocks new commands from coming in, although
 * if the Master follows my protocol, new commands should not come in 
 * unless this unit is stuck and does not respond within the specified 
 * response timeout time, 5ms.
 *
 * After successful command processing, send an ack message back to master.
 *********************************************************************/
void processCmd() {
  u08 rc; // return code from handler funcs
  // get a pointer to the data portion of RX buffer
  cBuffer* myRxBufferPtr;
  unsigned char * myRxBufferDataPtr;
  myRxBufferPtr = uartGetRxBuffer();
  myRxBufferDataPtr = myRxBufferPtr->dataptr;
  
  while (*myRxBufferDataPtr) { // do until we are at the null term (end of cmd)
    switch(*myRxBufferDataPtr++) { // get a char and then increment ptr
      // SET Address
      case 'a':
        rc = setCommandProtocolAddr(atoi((char *)myRxBufferDataPtr));
        if (rc) {
          customResponse = TRUE;
          sprintf_P(sprintbuf,PSTR("err-badaddr$"));
          sendMsg();
        }
        // use EEPROM to store address between powerups. Only reprogram on non-global addr.
        pointToNextNonNumericChar(&myRxBufferDataPtr);
        break; // End 'a' command
       
      // Input Data String into a volatile variable on the arduino
      case 'b': case 'B':
        //; // "a label can only be a part of a statement" <= the following line declares a variable first
        CRITICAL_SECTION_START;
        setVolatileString(myRxBufferDataPtr);
        CRITICAL_SECTION_END;
        break; // End 'b' command
       
      // Get info
      case 'g': case 'G':
        // Indicate to cmd protocol that we are sending a custom ack
        customResponse = TRUE;
        // select sub-command
        switch(*myRxBufferDataPtr++) {
          case 'a': case 'A':
            sprintf_P(sprintbuf, PSTR("g%d$"), getCommandProtocolAddr());
            // SPECIAL CASE!! we WANT to get the address back on a global command!
            // You can only have ONE device on the net for this to work. Otherwise, user beware!
            rxAddrGlobal = FALSE;
            sendMsg();
            break;
          
          case 'b': case 'B':
            sprintf_P(sprintbuf, PSTR("g%s$"), getVolatileString());
            sendMsg();
            break;
            
          default:
            sprintf_P(sprintbuf,PSTR("err-getnoprop$"));
            sendMsg();
        }
        break; // end 'g' command
        
      default:
        customResponse = TRUE;
        sprintf_P(sprintbuf, PSTR("err-cmd$"));
    } // end switch on command
  } // end while more data
}

void setVolatileString(unsigned char *newString) {
  // limit the copy to 
  if (sizeof(newString) >= 39) { // sizeof does ptr len or string+null len??
    strncpy((char *)&myVolatileStr, (char *)newString, 39);
  } else {
    strcpy((char *)&myVolatileStr, (char *)newString);
  }  
}

unsigned char * getVolatileString(void) {
  return &myVolatileStr;
}

void loopRefreshingDisplay(void) {

  // temporary holders for color data, for loading from pgm mem into buffer.
  u08 tempR;
  u08 tempG;
  u08 tempB;
  u16 i; // common loop iterator, used for clearing and setting buffer
  u08 div = 10; // divide brightness of raw data by this num
  u08 picnum = 1; // start on 1st image

  /* Loop forever refreshing the display rotating between 4 images */
  while (1) {
    /* Build buffer from array data, 1st half!! */
    
    // clear buffer
    for (i=0;i<NUM_LEDS;i++) {
      buf[i]=0;
    }
    
    // begin at top of buffer, work back to 0
    bufindex = 120;
    
    for (i=0;i<NUM_LEDS;) { // i is incremented +3 each loop
      //fill temp values of BGR from curr pic
      switch (picnum) {
        case 1:
        tempB = pgm_read_byte(&(block1[i++]));
        tempG = pgm_read_byte(&(block1[i++]));
        tempR = pgm_read_byte(&(block1[i++]));
        break;
        case 2:
        tempB = pgm_read_byte(&(block2[i++]));
        tempG = pgm_read_byte(&(block2[i++]));
        tempR = pgm_read_byte(&(block2[i++]));
        break;
        case 3:
        tempB = pgm_read_byte(&(block3[i++]));
        tempG = pgm_read_byte(&(block3[i++]));
        tempR = pgm_read_byte(&(block3[i++]));
        break;
        case 4:
        tempB = pgm_read_byte(&(block4[i++]));
        tempG = pgm_read_byte(&(block4[i++]));
        tempR = pgm_read_byte(&(block4[i++]));
        break;
      }
      
      // use div to reduce max brightness
      tempR = tempR/div;
      tempG = tempG/div;
      tempB = tempB/div;
      
      //put values in buffer, in the correct order
      bufindex--;
      buf[bufindex] = tempB;
      bufindex--;
      buf[bufindex] = tempR;
      bufindex--;
      buf[bufindex] = tempG;
    }
    output_grb3(buf, sizeof(buf));
    
    
    
    /* Build buffer from array data, 2nd half!! */
    //reinit for second half
    for (i=0;i<NUM_LEDS;i++) {
      buf[i]=0;
    }
    
    //fill buffer with second half of array
    bufindex = 120;
    
    for (i=NUM_LEDS;i<NUM_LEDS*2;) { // i is incremented +3 each loop
      //fill temp values of colors
      switch (picnum) {
        case 1:
        tempB = pgm_read_byte(&(block1[i++]));
        tempG = pgm_read_byte(&(block1[i++]));
        tempR = pgm_read_byte(&(block1[i++]));
        break;
        case 2:
        tempB = pgm_read_byte(&(block2[i++]));
        tempG = pgm_read_byte(&(block2[i++]));
        tempR = pgm_read_byte(&(block2[i++]));
        break;
        case 3:
        tempB = pgm_read_byte(&(block3[i++]));
        tempG = pgm_read_byte(&(block3[i++]));
        tempR = pgm_read_byte(&(block3[i++]));
        break;
        case 4:
        tempB = pgm_read_byte(&(block4[i++]));
        tempG = pgm_read_byte(&(block4[i++]));
        tempR = pgm_read_byte(&(block4[i++]));
        break;
      }
      tempR = tempR/div;
      tempG = tempG/div;
      tempB = tempB/div;
      
      //put values in buffer, in the correct order
      bufindex--;
      buf[bufindex] = tempB;
      bufindex--;
      buf[bufindex] = tempR;
      bufindex--;
      buf[bufindex] = tempG;
    }
    //output second half
    output_grb4(buf, sizeof(buf));
    

    
    // sel next picture data
    if (picnum < 4){
      picnum++;
      } else {
      picnum = 1;
    }
    
    // delay 1 second before rendering the next image
    _delay_ms(1000);
    
  } // end WHILE 1 loop
}